## drivers/iio/pulse/Kconfig
```kconfig
#
# Pulse Capture Devices
#
# When adding new entries keep the list in alphabetical order

menu "Pulse Capture Devices"

config IIO_TIECAP
	tristate "TI ECAP Pulse Capture"
	depends on ARCH_OMAP2PLUS || ARCH_DAVINCI_DA8XX || ARCH_KEYSTONE || ARCH_K3 | COMPILE_TEST
	select IIO_BUFFER
	select IIO_TRIGGERED_BUFFER
	help
	  If you say yes here you get support for the TI ECAP peripheral
	  in pulse capture mode.
	  
	  This driver can also be build as a module. If so, the module
	  will be called tiecap
```
